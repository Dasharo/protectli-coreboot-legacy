## src/mainboard/protectli/Kconfig
```kconfig
if VENDOR_PROTECTLI

choice
	prompt "Mainboard model"

source "src/mainboard/protectli/*/Kconfig.name"

endchoice

source "src/mainboard/protectli/*/Kconfig"

config MAINBOARD_VENDOR
	default "Protectli"

endif # VENDOR_PROTECTLI

if VENDOR_YANLING

choice
	prompt "Mainboard model"

source "src/mainboard/protectli/*/Kconfig.name"

endchoice

source "src/mainboard/protecli/*/Kconfig"

config MAINBOARD_VENDOR
	default "Yanling"

endif # VENDOR_YANLING
```

## src/mainboard/protectli/Kconfig.name
```kconfig
config VENDOR_PROTECTLI
	bool "Protectli"

config VENDOR_YANLING
	bool "Yanling"
```

## src/mainboard/protectli/vault/Kconfig
```kconfig
if BOARD_PROTECTLI_FW2B || BOARD_PROTECTLI_FW4B

config BOARD_SPECIFIC_OPTIONS
	def_bool y
	select BOARD_ROMSIZE_KB_8192
	select HAVE_ACPI_RESUME
	select HAVE_ACPI_TABLES
	select HAVE_OPTION_TABLE
	select SOC_INTEL_BRASWELL
	select PCIEXP_L1_SUB_STATE
	select C_ENVIRONMENT_BOOTBLOCK
	select GENERIC_SPD_BIN
	select SUPERIO_ITE_IT8613E
	select SOC_INTEL_COMMON_BLOCK
	select SOC_INTEL_COMMON_BLOCK_SMBUS

config MAINBOARD_DIR
	string
	default protectli/vault

config VARIANT_DIR
	string
	default "fw2b" if BOARD_PROTECTLI_FW2B
	default "fw4b" if BOARD_PROTECTLI_FW4B

config DEVICETREE
	string
	default "variants/$(CONFIG_VARIANT_DIR)/devicetree.cb"

config MAINBOARD_PART_NUMBER
	string
        default "fw2b" if BOARD_PROTECTLI_FW2B
        default "fw4b" if BOARD_PROTECTLI_FW4B

config MAINBOARD_VENDOR
	string
	default "Protectli"

config DIMM_MAX
	int
	default 1

config MAX_CPUS
	int
	default 2 if BOARD_PROTECTLI_FW2B
	default 4 if BOARD_PROTECTLI_FW4B

config PXE_ROM_ID
	string
	default "8086,1539" if BOARD_PROTECTLI_FW2B
	default "8086,157b" if BOARD_PROTECTLI_FW4B

if !RUN_FSP_GOP
config VGA_BIOS_FILE
	string
	default "3rdparty/blobs/mainboard/protectli/vault/vgabios.bin"
	help
	  The C0 version of the video bios gets computed from this name
	  so that they can both be added.  Only the correct one for the
	  system will be run.

config VGA_BIOS_ID
	string
	default "8086,22b0"
	help
	  The VGA_BIOS_ID for the C0 version of the video bios is hardcoded
	  in soc/intel/braswell/Makefile.inc as 8086,22b1

endif #GOP_SUPPORT

endif # BOARD_PROTECTLI_FW2B
```

## src/mainboard/protectli/vault_kbl/Kconfig
```kconfig
if BOARD_PROTECTLI_FW6A || BOARD_PROTECTLI_FW6B || BOARD_PROTECTLI_FW6C

config BOARD_SPECIFIC_OPTIONS
	def_bool y
	select BOARD_ROMSIZE_KB_8192
	select HAVE_ACPI_RESUME
	select HAVE_ACPI_TABLES
	select SOC_INTEL_KABYLAKE
	select MAINBOARD_USES_FSP2_0
	select SUPERIO_ITE_IT8772F

config IRQ_SLOT_COUNT
	int
	default 18

config MAINBOARD_DIR
	string
	default "protectli/vault_kbl"

config MAINBOARD_PART_NUMBER
	string
	default "FW6"

config PRERAM_CBMEM_CONSOLE_SIZE
	hex
	default 0xd00

config DIMM_MAX
	int
	default 2

config DIMM_SPD_SIZE
	int
	default 512

config USE_INTEL_FSP_MP_INIT
	bool
	default n

config USE_COREBOOT_NATIVE_MP_INIT
	bool
	default y

config MAX_CPUS
	int
	default 2 if BOARD_PROTECTLI_FW6A
	default 4

config VGA_BIOS_ID
	string
	default "8086,5906" if BOARD_PROTECTLI_FW6A
	default "8086,5916"

endif
```

## src/mainboard/protectli/vault_kbl/Kconfig.name
```kconfig
config BOARD_PROTECTLI_FW6
	bool "FW6"
config BOARD_YANLING_YLKBR6L
	bool "YLKBR6L"
```
